/* Sketch generated by the Arduino IoT Cloud Thing "Untitled"
  Variables: CloudSwitch switch1, switch2, switch3, switch4
*/

#include "thingProperties.h"

// Shifted from D4 to D1 to avoid ESP8266 boot-loop issues
#define STATUS_LED D1 

void setup() {
  // Set up the indicator LED pin
  pinMode(STATUS_LED, OUTPUT);
  digitalWrite(STATUS_LED, HIGH); // Default OFF if active-low

  // Clean initialization of standard hardware serial (Matches LPC2129 configuration)
  Serial.begin(9600, SERIAL_8N1);
  
  // Give the serial chip a brief moment to stabilize
  delay(1500); 

  // Initialize properties defined in thingProperties.h
  initProperties();

  // Connect to Arduino IoT Cloud
  ArduinoCloud.begin(ArduinoIoTPreferredConnection);
  
  // Debug tracking (Level 2 prints routing connections)
  setDebugMessageLevel(2);
  ArduinoCloud.printDebugInfo();
}

void loop() {
  ArduinoCloud.update();
}

/*
  Executed every time switch1 updates from the Dashboard.
*/
void onSwitch1Change()  {
  if(switch1 == 1) {
    digitalWrite(STATUS_LED, LOW); // Local indicator ON
    Serial.print('L');             // Turn ON Light 1 on LPC2129
  } 
  else {
    digitalWrite(STATUS_LED, HIGH); // Local indicator OFF
    Serial.print('l');              // Turn OFF Light 1 on LPC2129
  }
}

/*
  Executed every time switch2 updates from the Dashboard.
*/
void onSwitch2Change()  {
  if(switch2 == 1) {
    Serial.print('B'); // Turn ON Light 2 on LPC2129
  } 
  else {
    Serial.print('b'); // Turn OFF Light 2 on LPC2129
  }
}

/*
  Executed every time switch3 updates from the Dashboard.
*/
void onSwitch3Change()  {
  if(switch3 == 1) {
    Serial.print('F'); // Turn ON Fan 1 on LPC2129
  } 
  else {
    Serial.print('f'); // Turn OFF Fan 1 on LPC2129
  }
}

/*
  Executed every time switch4 updates from the Dashboard.
*/
void onSwitch4Change()  {
  if(switch4 == 1) {
    Serial.print('T'); // Turn ON Fan 2 on LPC2129
  } 
  else {
    Serial.print('t'); // Turn OFF Fan 2 on LPC2129
  }
}
